#include "spi_bus.hpp"
#include "AS5047U.hpp"
#include "cmsis_os.h"
#include "main.h"          // HAL handles

// ---------- SPI handle & CS pin generated by Cube ----------
extern SPI_HandleTypeDef hspi1;       // or hspi2/3…
#define ENCODER_CS_GPIO   GPIOB
#define ENCODER_CS_PIN    GPIO_PIN_12

// ---------- Globals ----------
static AS5047U       *enc = nullptr;
static osMutexId_t    spiMtx;

// ---------- Helper: lock/unlock ----------
class Locker {
public:
    Locker(osMutexId_t m) : mtx(m) { osMutexAcquire(mtx, osWaitForever); }
    ~Locker() { osMutexRelease(mtx); }
private:
    osMutexId_t mtx;
};

// ---------- FreeRTOS tasks ----------
void AngleTask(void*, osPriority_t, uint32_t, const char*);

void AngleTask(void*, osPriority_t, uint32_t, const char*)
{
    for (;;) {
        {
            Locker lock(spiMtx);
            uint16_t raw = enc->getAngle(1);
            printf("Angle %5u (%.2f°)\r\n", raw, raw * 360.0 / 16384.0);
        }
        osDelay(100);
    }
}

void DiagTask(void*, osPriority_t, uint32_t, const char*);

void DiagTask(void*, osPriority_t, uint32_t, const char*)
{
    for (;;) {
        {
            Locker lock(spiMtx);
            printf("AGC=%3u  MAG=%5u\r\n",
                   enc->getAGC(), enc->getMagnitude());
        }
        osDelay(500);
    }
}

void ErrTask(void*, osPriority_t, uint32_t, const char*);

void ErrTask(void*, osPriority_t, uint32_t, const char*)
{
    for (;;) {
        {
            Locker lock(spiMtx);
            auto err = enc->getStickyErrorFlags();
            if (err != AS5047U_Error::None) {
                printf("ERR 0x%04X\r\n", static_cast<uint16_t>(err));
            }
        }
        osDelay(1000);
    }
}
